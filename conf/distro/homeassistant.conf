## conf/distro/homeassistant.conf
```bitbake
require conf/distro/poky.conf
include conf/distro/include/ha-versions.inc

DISTRO = "homeassistant"
DISTRO_NAME = "HomeAssistant Linux Distro"
DISTRO_VERSION = "2026.2.0"

DISTRO_FEATURES += "systemd usrmerge"
DISTRO_FEATURES:remove = "sysvinit"

# Use systemd as init manager
VIRTUAL-RUNTIME_init_manager = "systemd"
VIRTUAL-RUNTIME_initscripts = "systemd-compat-units"
VIRTUAL-RUNTIME_login_manager = "shadow-base"
VIRTUAL-RUNTIME_dev_manager = "udev"
```
